## config/west.yml
```yaml
manifest:
  remotes:
    - name: ruslanch
      url-base: https://github.com/ruslanch
  projects:
    - name: zmk
      remote: ruslanch
      revision: main
      import: app/west.yml
    - name: zmk-component-raytac-dongle
      remote: ruslanch
      revision: main
  self:
    path: config
```
